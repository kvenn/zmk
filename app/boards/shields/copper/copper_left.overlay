/*
 * Copyright (c) 2020 Derek Schmell
 *
 * SPDX-License-Identifier: MIT
 */

#include "copper.dtsi"

// NOTE: pin A2 used for COL 3 due to mysterious error
&kscan0 {
	col-gpios
		= <&pro_micro_a  1 GPIO_ACTIVE_HIGH>
		, <&pro_micro_a  0 GPIO_ACTIVE_HIGH>
		, <&pro_micro_a  2 GPIO_ACTIVE_HIGH>
		, <&pro_micro_d  14 GPIO_ACTIVE_HIGH>
		, <&pro_micro_d  16 GPIO_ACTIVE_HIGH>
		, <&pro_micro_d  10 GPIO_ACTIVE_HIGH>
		;
};
