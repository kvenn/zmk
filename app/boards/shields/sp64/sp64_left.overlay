/*
 * Copyright (c) 2020 Derek Schmell
 *
 * SPDX-License-Identifier: MIT
 */

#include "sp64.dtsi"

&kscan0 {
	col-gpios
		= <&pro_micro_d  21 GPIO_ACTIVE_HIGH>
		, <&pro_micro_d  20 GPIO_ACTIVE_HIGH>
		, <&pro_micro_d  19 GPIO_ACTIVE_HIGH>
		, <&pro_micro_d  18 GPIO_ACTIVE_HIGH>
		, <&pro_micro_d  15 GPIO_ACTIVE_HIGH>
		, <&pro_micro_d  14 GPIO_ACTIVE_HIGH>
		, <&pro_micro_d  16 GPIO_ACTIVE_HIGH>
		;
};
