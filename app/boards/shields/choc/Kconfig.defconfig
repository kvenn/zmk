## app/boards/shields/choc/Kconfig.defconfig
```kconfig
#Copyright (c) 2020 Derek Schmell
#SPDX-License-Identifier: MIT
 
 
if SHIELD_EXECUTIVE_SLIMLINE_LEFT

config ZMK_KEYBOARD_NAME
	default "Executive Slimline"

config ZMK_SPLIT_BLE_ROLE_CENTRAL
	default y

endif

if SHIELD_EXECUTIVE_SLIMLINE_RIGHT

config ZMK_KEYBOARD_NAME
	default "Executive Slimline Right"

endif

if SHIELD_EXECUTIVE_SLIMLINE_LEFT || SHIELD_EXECUTIVE_SLIMLINE_RIGHT

config ZMK_SPLIT
	default y

endif
```

## app/boards/shields/choc/Kconfig.shield
```kconfig
# Copyright (c) 2020 Derek Schmell
# SPDX-License-Identifier: MIT

config SHIELD_EXECUTIVE_SLIMLINE_LEFT
	def_bool $(shields_list_contains,executive_slimline_left)

config SHIELD_EXECUTIVE_SLIMLINE_RIGHT
	def_bool $(shields_list_contains,executive_slimline_right)
```

## app/boards/shields/copper/Kconfig.defconfig
```kconfig
#Copyright (c) 2020 Derek Schmell
#SPDX-License-Identifier: MIT
 
 
if SHIELD_COPPER_LEFT

config ZMK_KEYBOARD_NAME
	default "Copper Left"

config ZMK_SPLIT_BLE_ROLE_CENTRAL
	default y

endif

if SHIELD_COPPER_RIGHT

config ZMK_KEYBOARD_NAME
	default "Copper Right"

endif

if SHIELD_COPPER_LEFT || SHIELD_COPPER_RIGHT

config ZMK_SPLIT
	default y

endif
```

## app/boards/shields/copper/Kconfig.shield
```kconfig
# Copyright (c) 2020 Derek Schmell
# SPDX-License-Identifier: MIT

config SHIELD_COPPER_LEFT
	def_bool $(shields_list_contains,copper_left)

config SHIELD_COPPER_RIGHT
	def_bool $(shields_list_contains,copper_right)
```

## app/boards/shields/cream/Kconfig.defconfig
```kconfig
#Copyright (c) 2020 Derek Schmell
#SPDX-License-Identifier: MIT
 
 
if SHIELD_CREAM_LEFT

config ZMK_KEYBOARD_NAME
	default "Cream Left"

endif

if SHIELD_CREAM_RIGHT

config ZMK_KEYBOARD_NAME
	default "Cream Right"

config ZMK_SPLIT_BLE_ROLE_CENTRAL
	default y

endif

if SHIELD_CREAM_LEFT || SHIELD_CREAM_RIGHT

config ZMK_SPLIT
	default y

endif
```

## app/boards/shields/cream/Kconfig.shield
```kconfig
# Copyright (c) 2020 Derek Schmell
# SPDX-License-Identifier: MIT

config SHIELD_CREAM_LEFT
	def_bool $(shields_list_contains,cream_left)

config SHIELD_CREAM_RIGHT
	def_bool $(shields_list_contains,cream_right)
```

## app/boards/shields/decopad/Kconfig.defconfig
```kconfig
#Copyright (c) 2020 Derek Schmell
#SPDX-License-Identifier: MIT
 
 
if SHIELD_DECOPAD_LEFT

config ZMK_KEYBOARD_NAME
	default "Decopad Left"

config ZMK_SPLIT_BLE_ROLE_CENTRAL
	default y

endif

if SHIELD_DECOPAD_RIGHT

config ZMK_KEYBOARD_NAME
	default "Decopad Right"

endif

if SHIELD_DECOPAD_LEFT || SHIELD_DECOPAD_RIGHT

config ZMK_SPLIT
	default y

endif
```

## app/boards/shields/decopad/Kconfig.shield
```kconfig
# Copyright (c) 2020 Derek Schmell
# SPDX-License-Identifier: MIT

config SHIELD_DECOPAD_LEFT
	def_bool $(shields_list_contains,decopad_left)

config SHIELD_DECOPAD_RIGHT
	def_bool $(shields_list_contains,decopad_right)
```

## app/boards/shields/sp64/Kconfig.defconfig
```kconfig
#Copyright (c) 2020 Derek Schmell
#SPDX-License-Identifier: MIT
 
 
if SHIELD_SP64_LEFT

config ZMK_KEYBOARD_NAME
	default "SP64 Left"

config ZMK_SPLIT_BLE_ROLE_CENTRAL
	default y

endif

if SHIELD_SP64_RIGHT

config ZMK_KEYBOARD_NAME
	default "SP64 Right"

endif

if SHIELD_SP64_LEFT || SHIELD_SP64_RIGHT

config ZMK_SPLIT
	default y

endif
```

## app/boards/shields/sp64/Kconfig.shield
```kconfig
# Copyright (c) 2020 Derek Schmell
# SPDX-License-Identifier: MIT

config SHIELD_SP64_LEFT
	def_bool $(shields_list_contains,sp64_left)

config SHIELD_SP64_RIGHT
	def_bool $(shields_list_contains,sp64_right)
```

## app/boards/shields/tetons/Kconfig.defconfig
```kconfig
#Copyright (c) 2020 Derek Schmell
#SPDX-License-Identifier: MIT
 
 
if SHIELD_TETONS_LEFT

config ZMK_KEYBOARD_NAME
	default "Tetons"

endif

if SHIELD_TETONS_RIGHT

config ZMK_KEYBOARD_NAME
	default "Tetons Right"

endif

if SHIELD_TETONS_LEFT || SHIELD_TETONS_RIGHT

endif
```

## app/boards/shields/tetons/Kconfig.shield
```kconfig
# Copyright (c) 2020 Derek Schmell
# SPDX-License-Identifier: MIT

config SHIELD_TETONS_LEFT
	def_bool $(shields_list_contains,tetons_left)

config SHIELD_TETONS_RIGHT
	def_bool $(shields_list_contains,tetons_right)
```
