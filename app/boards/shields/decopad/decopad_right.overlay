/*
 * Copyright (c) 2020 Derek Schmell
 *
 * SPDX-License-Identifier: MIT
 */
 
#include "decopad.dtsi"

&default_transform {
	col-offset = <6>;
};

&kscan0 {
	col-gpios
		= <&pro_micro_d  5 GPIO_ACTIVE_HIGH>
		, <&pro_micro_d  4 GPIO_ACTIVE_HIGH>
		, <&pro_micro_d  3 GPIO_ACTIVE_HIGH>
		, <&pro_micro_d  2 GPIO_ACTIVE_HIGH>
		, <&pro_micro_d  0 GPIO_ACTIVE_HIGH>
		, <&pro_micro_d  1 GPIO_ACTIVE_HIGH>
		;
};
